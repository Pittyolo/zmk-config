## config/boards/shields/neito/Kconfig.defconfig
```kconfig
# Copyright (c) 2021 The ZMK Contributors
# SPDX-License-Identifier: MIT

if SHIELD_NEITO

config ZMK_KEYBOARD_NAME
    default "neito"

endif
```
